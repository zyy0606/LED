//****************************************Copyright (c)**************************************************
//                       基 于 OpenM0V 试 验 板 程 序                            
//
// 这部分程序基于IAR EWARM6.50编译环境
// 
// 芯片型号          : STM32F051R8T6
// 晶振频率          : 8.000000 MHz
//
//--------------文件信息--------------------------------------------------------------------------------
//文   件   名: systick.c
//创   建   人:喻金钱
//最后修改日期: 2013年11月05日
//描        述: 系统定时器中断程序，
//              
//店      铺：

//********************************************************************************************************/


#include "stm32f0xx.h"//
#include "gpio.h"
#include "adc.h"

unsigned char sys_sig=0;

void SysTick_Handler(void)
{
  if(key_bit & 0x04)//如果允许延时标志被置位的话
    {
      if(key_bit & 0x80)   //加入这个判断，只有当两次进入中断后才置位延时标志
        {
           key_bit |= 0x01;   //置位延时标志，表明经过延时
           key_bit &= ~0x04;  //清 允许延时标志位置位 标志位
           key_bit &= ~0x80;
        }
     else   //如果第7位没有置位，说明是第一次进入中断
       {
           key_bit |= 0x80;  //第一次进入时，把key_bit第7位置位。
       }
    }
  
  sys_sig++;
  if(sys_sig > 50) //每隔25个中断，跳变一次LED3灯
  {
    sys_sig = 0; 
    adc_sig = 1;  //置读ADC标志位
    LED3B();
  }
}




